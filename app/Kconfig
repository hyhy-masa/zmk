## app/dts/bindings/behaviors/zmk,behavior-data-logger.yaml
```yaml
# Copyright (c) 2026 The minimal-keys Contributors
# SPDX-License-Identifier: MIT

description: Data Logger Control Behavior

compatible: "zmk,behavior-data-logger"

include: one_param.yaml
```

## app/west.yml
```yaml
manifest:
  remotes:
    - name: zephyrproject-rtos
      url-base: https://github.com/zephyrproject-rtos
    - name: zmkfirmware
      url-base: https://github.com/zmkfirmware
    - name: cormoran
      url-base: https://github.com/cormoran
    - name: hyhy-masa
      url-base: https://github.com/hyhy-masa
  projects:
    - name: zephyr
      remote: hyhy-masa
      revision: v3.5.0+zmk-fixes+mk
      clone-depth: 1
      import:
        name-blocklist:
          - ci-tools
          - hal_altera
          - hal_cypress
          - hal_infineon
          - hal_microchip
          - hal_nxp
          - hal_openisa
          - hal_silabs
          - hal_xtensa
          - hal_st
          - hal_ti
          - loramac-node
          - mcuboot
          - mcumgr
          - net-tools
          - openthread
          - edtt
          - trusted-firmware-m
    - name: nanopb
      revision: 8c60555d6277a0360c876bd85d491fc4fb0cd74a
      path: modules/lib/nanopb
      remote: zmkfirmware
    - name: zmk-studio-messages
      # custom-studio-protocol
      remote: cormoran
      revision: 89b81d2e587fce807b668dff2a6967a40beef421
      path: modules/msgs/zmk-studio-messages
  self:
    west-commands: scripts/west-commands.yml
```
